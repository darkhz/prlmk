## drivers/video/Kconfig
```kconfig
#
# Video configuration
#

menu "Graphics support"
	depends on HAS_IOMEM

config HAVE_FB_ATMEL
	bool

config SH_LCD_MIPI_DSI
	bool

config PROJECT_VINCE
        bool "XIAOMI E7 use"
        ---help---
        diff touch and lcd in E7 project.

config PROJECT_SAKURA
        bool "XIAOMI D1S use"
        ---help---
        diff touch and lcd in D1S project.

source "drivers/char/agp/Kconfig"

source "drivers/gpu/vga/Kconfig"

source "drivers/gpu/host1x/Kconfig"
source "drivers/gpu/ipu-v3/Kconfig"
source "drivers/gpu/msm/Kconfig"

source "drivers/gpu/drm/Kconfig"

menu "Frame buffer Devices"
source "drivers/video/fbdev/Kconfig"
endmenu

source "drivers/video/backlight/Kconfig"
source "drivers/video/adf/Kconfig"

config VGASTATE
       tristate
       default n

config VIDEOMODE_HELPERS
	bool

config HDMI
	bool

if VT
	source "drivers/video/console/Kconfig"
endif

if FB || SGI_NEWPORT_CONSOLE
	source "drivers/video/logo/Kconfig"

endif


endmenu
```
